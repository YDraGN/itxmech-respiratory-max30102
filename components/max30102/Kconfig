## components/max30102/Kconfig
```kconfig
menu "MAX30102"

    config MAX30102_PIN_SDA
        int "Chân SDA"
        default 8
        help
            Theo sơ đồ mạch hiện tại SDA = GPIO8. Trên SuperMini GPIO8 là chân strapping
            (nối LED xanh trên board): giữ điện trở kéo lên để boot bình thường.

    config MAX30102_PIN_SCL
        int "Chân SCL"
        default 9
        help
            Theo sơ đồ mạch hiện tại SCL = GPIO9 (cũng là nút BOOT trên SuperMini).

    config MAX30102_I2C_HZ
        int "Tốc độ I2C (Hz)"
        default 400000

    config MAX30102_LED_CURRENT
        hex "Dòng LED RED/IR (thanh ghi 0x0C/0x0D)"
        default 0x36
        help
            0x36 khoảng 11 mA, phù hợp đo ở cổ tay. Tăng nếu tín hiệu AC yếu.

endmenu
```

## main/Kconfig.projbuild
```kconfig
menu "RespiCare wristband"

    config RESPI_DEVICE_ID
        string "device_id (để trống = WB-C3-XXXX theo MAC)"
        default ""
        help
            Phải trùng với id server cấp cho thiết bị. Để trống thì firmware tự đặt
            WB-C3-XXXX, với XXXX là 4 ký tự cuối địa chỉ MAC Bluetooth.

    menu "Chân GPIO"
        config RESPI_PIN_LED_RED
            int "LED đỏ"
            default 4
        config RESPI_PIN_LED_GREEN
            int "LED xanh"
            default 5
        config RESPI_LED_ACTIVE_HIGH
            bool "LED sáng khi ghi mức 1"
            default y
        config RESPI_PIN_MAX_INT
            int "Chân INT của MAX30102 (chỉ cấu hình input, chưa dùng ngắt)"
            default 10
    endmenu

    menu "Kết nối và dự phòng"
        config RESPI_APP_WAIT_S
            int "Số giây chờ app trước khi chuyển sang chế độ tự chạy"
            default 60
            help
                Sau khi khởi động hoặc mất BLE, nếu không có app nào bắt tay xong
                (SET_GATEWAY(1)) trong khoảng này thì vòng tự lưu dữ liệu và chờ uplink.

        config RESPI_LED_SEARCH_S
            int "Số giây nháy nhanh báo đang tìm BLE (0 = nháy đến khi có app)"
            default 60
            help
                Hết thời gian này LED quay lại báo trạng thái cảm biến như cũ để
                không che mất thông tin đeo/không đeo và tiết kiệm pin.

        config RESPI_ADV_FAST_S
            int "Số giây quảng bá nhanh (200 ms) sau khi khởi động hoặc mất kết nối"
            default 120

        config RESPI_BACKFILL_KEEP_ACKED
            int "Số bản ghi đã ACK vẫn gửi lại khi có BACKFILL từ điện thoại khác"
            default 1440
            help
                ACK chỉ đánh dấu, bản ghi còn trong flash đến khi bị ghi đè. Khi một
                điện thoại khác kết nối và xin BACKFILL từ seq cũ, vòng gửi lại tối đa
                chừng này bản ghi tính ngược từ acked_seq (mặc định 24 giờ).
    endmenu

    menu "Gỡ lỗi"
        config RESPI_MINUTE_PERIOD_S
            int "Độ dài một 'phút' (giây)"
            default 60
            help
                Chỉ giảm khi thử BLE/RECORDS cho nhanh. Model được huấn luyện theo phút
                thật, giảm giá trị này thì kết quả cảnh báo không còn ý nghĩa.

        config RESPI_LOG_EVERY_SECOND
            bool "In log SpO2/HR mỗi giây"
            default n
            help
                Mỗi RESPI_LIVE_PERIOD_S giây đã có một dòng "live |". Bật mục này khi cần
                xem từng giây (tốn CPU cho UART và đầy nhật ký BLE nhanh hơn).

        config RESPI_BLE_DEBUG_LOG
            bool "Gửi nhật ký qua BLE (characteristic DEBUG_LOG a51c000b)"
            default n
            help
                Khi bật, máy nào bật notify DEBUG_LOG (nRF Connect hoặc màn Nhật ký vòng
                trong app) nhận được các dòng log như trên cổng USB, để thử ngoài thực tế
                không cần cắm máy tính. Chỉ dùng ở bản thử nghiệm.
    endmenu

    menu "Hiển thị và đo hiệu năng"
        config RESPI_LIVE_PERIOD_S
            int "Chu kỳ LIVE (giây): số hiển thị chung cho app, người nhà và web"
            range 5 60
            default 15
            help
                Vòng gộp các giây trong khoảng này (trung bình / nhỏ nhất) rồi gửi một gói LIVE.
                App gateway chuyển lên server để mọi máy thấy cùng một số.

        config RESPI_DIAG_PERIOD_MIN
            int "Chu kỳ DIAG (phút): số liệu CPU / thời gian xử lý"
            range 1 60
            default 5
            help
                Nên bằng nhịp chạy model (5 phút) để mỗi cửa sổ có đúng một lần chạy model.
    endmenu

endmenu
```
